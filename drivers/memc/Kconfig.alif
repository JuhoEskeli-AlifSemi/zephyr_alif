## drivers/memc/Kconfig.alif
```kconfig
# Copyright (c) 2025 Alif Semiconductor
#
# SPDX-License-Identifier: Apache-2.0

config MEMC_OSPI_ALIF
	bool "ALIF OSPI Memory controller"
	default y
	depends on DT_HAS_SNPS_DESIGNWARE_OSPI_ENABLED
	help
	  Enable OSPI Memory Controller.

if MEMC_OSPI_ALIF

config MEMC_ALIF_OSPI_APS512XXN
	bool "ALIF OSPI AP-Memory PSRAM driver"
	default y
	depends on DT_HAS_ALIF_APMEMORY_APS512XXN_ENABLED
	help
	  Enable support for the AP-Memory APS512XXN PSRAM device on Alif platforms.

config MEMC_ALIF_OSPI_IS66_HYPERRAM
	bool "ALIF OSPI ISSI IS66 HyperRAM driver"
	default y
	depends on DT_HAS_ALIF_IS66_HYPERRAM_ENABLED
	help
	  Enable support for the ISSI IS66WVH HyperRAM device on Alif platforms.
	  The device is accessed via HyperBus XIP on the OSPI0 controller.
	  Note: All writes to the XIP region must be 16-bit or 32-bit aligned;
	  byte writes are not supported by the HyperBus protocol.

endif
```

## drivers/serial/Kconfig.usb_cdc_acm
```kconfig
# Copyright (c) 2025 Alif Semiconductor
# SPDX-License-Identifier: Apache-2.0

config UART_USB_CDC_ACM_HOST
	bool "UART over USB Host CDC-ACM"
	depends on USB_HOST_STACK
	depends on USBH_CDC_ACM
	depends on DT_HAS_ZEPHYR_CDC_ACM_UART_ENABLED
	select UART_INTERRUPT_DRIVEN
	select RING_BUFFER
	select EXPERIMENTAL
	help
	  Enable the UART over USB Host CDC-ACM driver. This creates a
	  virtual UART device backed by a USB host CDC-ACM class driver,
	  allowing drivers that use the UART API (such as modem drivers)
	  to communicate with USB CDC-ACM devices (e.g., USB modems).

if UART_USB_CDC_ACM_HOST

config UART_USB_CDC_ACM_WORKQUEUE_PRIORITY
	int "UART USB CDC-ACM work queue priority"
	default MAIN_THREAD_PRIORITY
	help
	  Priority of the work queue used for CDC-ACM UART data transfers.

config UART_USB_CDC_ACM_WORKQUEUE_STACK_SIZE
	int "UART USB CDC-ACM work queue stack size"
	default 2048
	help
	  Stack size for the CDC-ACM UART work queue thread.

endif # UART_USB_CDC_ACM_HOST
```

## drivers/usb/uhc/Kconfig.dwc3
```kconfig
# Copyright (c) 2025 Alif Semiconductor
# SPDX-License-Identifier: Apache-2.0

config UHC_DWC3
	bool "Synopsys DWC3 USB Host Controller driver"
	default y
	depends on DT_HAS_SNPS_DWC3_HOST_ENABLED
	help
	  Enable the Synopsys DesignWare DWC3 USB Host Controller driver.
	  This driver operates the DWC3 IP in host mode, supporting
	  USB 2.0 High Speed and Full Speed devices.

if UHC_DWC3

config UHC_DWC3_THREAD_STACK_SIZE
	int "Driver internal thread stack size"
	default 2048
	help
	  Size of the stack used for the DWC3 UHC transfer processing thread.

config UVC_HOST
	bool "USB Video Class host helpers for the DWC3 host controller"
	help
	  UVC configuration descriptor parsing, Probe/Commit format
	  negotiation and frame reassembly from bulk or isochronous payloads,
	  on top of the DWC3 host controller helpers (uhc_dwc3.h).

if UVC_HOST

module = UVC_HOST
module-str = UVC host helpers
source "subsys/logging/Kconfig.template.log_config"

endif # UVC_HOST

endif # UHC_DWC3
```

## drivers/video/Kconfig.uvc_host
```kconfig
# Copyright (c) 2026 Alif Semiconductor
# SPDX-License-Identifier: Apache-2.0

config VIDEO_UVC_HOST
	bool "USB Video Class camera on the DWC3 host controller"
	default y
	depends on DT_HAS_ALIF_UVC_HOST_ENABLED
	depends on VIDEO && USB_HOST_STACK && UHC_DWC3
	select UVC_HOST
	select EVENTS
	help
	  Video device for a USB Video Class camera connected to the DWC3
	  USB host port. The camera is enumerated when it is plugged in; its
	  formats and frame sizes are then reported as the video
	  capabilities. Bulk and isochronous (also High-Speed high-bandwidth)
	  streaming endpoints are supported.

if VIDEO_UVC_HOST

config VIDEO_UVC_HOST_INIT_PRIORITY
	int "Init priority"
	default VIDEO_INIT_PRIORITY
	help
	  Device init priority (POST_KERNEL). Must be higher than that of the
	  USB host controller.

config VIDEO_UVC_HOST_THREAD_PRIORITY
	int "Streaming thread priority"
	default -5
	help
	  Priority of the thread that enumerates the camera and receives the
	  stream. An isochronous stream loses data when the queued transfers
	  are not resubmitted within 4 ms, so the default is a cooperative
	  priority, which application threads cannot preempt.

config VIDEO_UVC_HOST_THREAD_STACK_SIZE
	int "Streaming thread stack size"
	default 2048

config VIDEO_UVC_HOST_CAPS_TIMEOUT_MS
	int "Time video_get_caps() waits for a camera, in ms"
	default 0
	help
	  The capabilities are only known once a camera has been enumerated.
	  video_get_caps() waits up to this long for one, then returns
	  -EAGAIN. 0 waits forever.

module = VIDEO_UVC_HOST
module-str = UVC host video device
source "subsys/logging/Kconfig.template.log_config"

endif # VIDEO_UVC_HOST
```

## dts/bindings/gpio/snps,designware-gpio.yaml
```yaml
# Copyright (c) 2018 Synopsys, Inc. All rights reserved.
# SPDX-License-Identifier: Apache-2.0

description: Synopsys DesignWare GPIO node

compatible: "snps,designware-gpio"

include: [gpio-controller.yaml, pinctrl-device.yaml, base.yaml]

properties:
  reg:
    required: true

  multicore-ack-pins:
    type: array
    description: |
      List of pin numbers for which this core is responsible for
      acknowledging (PORTA_EOI) the GPIO interrupt. Used when
      multiple cores share the same GPIO controller. Pins not
      in this list but still enabled for interrupts will rely
      on the NVIC latch and let the other core acknowledge.
      Only meaningful when CONFIG_GPIO_DW_MULTICORE is enabled.

  "#gpio-cells":
    const: 2

gpio-cells:
  - pin
  - flags
```

## dts/bindings/mtd/alif,is66-hyperram.yaml
```yaml
# Copyright (c) 2025 Alif Semiconductor
#
# SPDX-License-Identifier: Apache-2.0

description: ISSI IS66 HyperRAM on ALIF OSPI (HyperBus) bus

compatible: "alif,is66-hyperram"

include: base.yaml

properties:
  size:
    type: int
    required: true
    description: |
      The RAM size in bytes.

  wait-cycles:
    type: int
    enum:
      - 3
      - 4
      - 5
      - 6
      - 7
    required: true
    description: |
      HyperRAM initial access latency (wait cycles). Must match operating
      frequency per IS66 datasheet:
      | Wait cycles | Max CLK (MHz) |
      | ----------- | ------------- |
      | 3           | 83            |
      | 4           | 100           |
      | 5           | 133           |
      | 6           | 166           |
      | 7           | 200           |

  reset-gpios:
    type: phandle-array
    description: |
      Optional GPIO connected to the HyperRAM nRST pin.
      If provided, the driver will assert a hardware reset pulse
      before initializing the controller.
```

## dts/bindings/serial/zephyr,cdc-acm-uart.yaml
```yaml
description: USB Host CDC-ACM UART bridge

  This binding defines a virtual UART backed by a USB host CDC-ACM
  class driver. It allows drivers that use the Zephyr UART API
  (such as modem drivers) to communicate with USB CDC-ACM devices
  (such as USB modems).

compatible: "zephyr,cdc-acm-uart"

properties:
  rx-fifo-size:
    type: int
    default: 2048
    description: |
      Size of the receive ring buffer in bytes.

  tx-fifo-size:
    type: int
    default: 2048
    description: |
      Size of the transmit ring buffer in bytes.
```

## dts/bindings/usb/snps,dwc3-host.yaml
```yaml
# Copyright (c) 2025 Alif Semiconductor
# SPDX-License-Identifier: Apache-2.0

description: DesignWare USB DWC3 Host Controller

compatible: "snps,dwc3-host"

include: [base.yaml]

properties:
  reg:
    required: true

  interrupts:
    required: true

  clocks:
    required: true

  maximum-speed:
    type: string
    description: |
      Maximum USB speed supported by the controller.

  num-in-eps:
    type: int
    required: true
    description: |
      Number of configured IN endpoints including control endpoint.

  num-out-eps:
    type: int
    required: true
    description: |
      Number of configured OUT endpoints including control endpoint.
```

## dts/bindings/video/alif,uvc-host.yaml
```yaml
# Copyright (c) 2026 Alif Semiconductor
# SPDX-License-Identifier: Apache-2.0

description: |
  USB Video Class camera connected to the DWC3 USB host controller.

  The camera is enumerated when it is plugged in and is then available as a
  video device. Only one instance is supported.

  Example:

    uvc_camera: uvc-camera {
        compatible = "alif,uvc-host";
        usb-controller = <&zephyr_uhc0>;
    };

compatible: "alif,uvc-host"

include: base.yaml

properties:
  usb-controller:
    type: phandle
    required: true
    description: USB host controller ("snps,dwc3-host") the camera is on.
```

## dts/bindings/video/aptina,mt9m114.yaml
```yaml
# Copyright (c) 2019, Linaro Limited
# Copyright 2024 NXP
#
# SPDX-License-Identifier: Apache-2.0

description: MT9M114 CMOS video sensor

compatible: "aptina,mt9m114"

include: [pinctrl-device.yaml, i2c-device.yaml]

properties:
  reset-gpios:
    type: phandle-array
    description: |
      The RESETn pin is asserted to disable the sensor causing a hard
      reset.  The sensor receives this as an active-low signal.

  power-gpios:
    type: phandle-array
    description: |
      The Power Pin is asserted to enable the 1.2 V, 1.8 V and 2.7 V signals
      needed by sensor. The sensor receives this as an active-high signal.

child-binding:
  child-binding:
    include: video-interfaces.yaml
```

## subsys/usb/host/Kconfig
```kconfig
# Copyright (c) 2022 Nordic Semiconductor ASA
#
# SPDX-License-Identifier: Apache-2.0

menuconfig USB_HOST_STACK
	bool "USB host stack [EXPERIMENTAL]"
	select EXPERIMENTAL
	select UHC_DRIVER
	help
	  New experimental USB host stack.

if USB_HOST_STACK

module = USBH
module-str = usbh
source "subsys/logging/Kconfig.template.log_config"

config USBH_USB_DEVICE_MAX
	int "Maximum number of USB devices supported."
	default 4
	range 2 127
	help
	  Maximum number of USB devices supported for all controllers.

config USBH_USB_DEVICE_HEAP
	int "Memory used to cache device descriptors"
	default 1024
	range 256 16384
	help
	  Memory used to cache device descriptors.

config USBH_SHELL
	bool "USB host shell"
	depends on SHELL
	help
	  Shell commands for USB host support.

config USBH_INIT_PRIO
	int
	default 90
	help
	  USB host thread initialization priority level.

config USBH_STACK_SIZE
	int "USB host stack thread stack size"
	default 1024
	help
	  USB host stack thread stack size in bytes.

config USBH_MAX_UHC_MSG
	int "Maximum number of UHC events"
	default 10
	help
	  Maximum number of USB host controller events that can be queued.

config USBH_CDC_ACM
	bool "USB host CDC-ACM class driver"
	help
	  Enable the USB host CDC-ACM class driver.
	  This allows the host to communicate with USB devices
	  presenting a CDC-ACM interface (e.g., USB modems,
	  USB-to-serial adapters).

config USBH_MSC
	bool "USB host Mass Storage class driver"
	depends on UHC_DWC3
	select DISK_ACCESS
	help
	  Enable the USB host Mass Storage (Bulk-Only Transport, SCSI
	  transparent command set) class driver. It enumerates a connected
	  USB mass storage device (e.g. a flash drive), runs the SCSI
	  discovery sequence and registers a disk-access device so a block
	  filesystem such as FAT can be mounted on the medium.

	  This driver currently uses the DWC3 host controller's synchronous
	  transfer helpers, hence the dependency on UHC_DWC3.

config USBH_MSC_DISK_NAME
	string "Disk-access name for the USB mass storage device"
	depends on USBH_MSC
	default "USB"
	help
	  Name under which the enumerated mass storage medium is registered
	  with the disk-access subsystem. To mount a FAT filesystem the name
	  must appear in the FatFs volume string table (FF_VOLUME_STRS); the
	  default "USB" maps to the mount point "/USB:".

rsource "Kconfig.usbip"

endif # USB_HOST_STACK
```
