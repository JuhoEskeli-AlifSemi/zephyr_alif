## dts/bindings/video/snps,designware-csi.yaml
```yaml
# Copyright (C) 2024 Alif Semiconductor
# SPDX-License-Identifier: Apache-2.0

description: MIPI CSI-2 controller IP used by Alif SoC.

compatible: "snps,designware-csi"

include: base.yaml

properties:
  interrupts:
    required: true

  data-lanes:
    type: int
    required: true
    default: 2
    description:
      Number of data lanes
    enum: [1, 2]

  phy-if:
    type: phandle
    required: true
    description:
      Handle to the PHY interface.

  ipi-mode:
    type: string
    required: false
    default: "Camera"
    description: |
      Video mode transmission type.
    enum: ["Camera", "Controller"]

  csi-vsa:
    type: int
    required: false
    description: |
      The Vertical Synchronism Active time in Horizontal lines.

  csi-vbp:
    type: int
    required: false
    description: |
      The Vertical back porch time in Horizontal lines.

  csi-vfp:
    type: int
    required: false
    description: |
      The Vertical front porch time in Horizontal lines.

  csi-vact:
    type: int
    required: false
    description: |
      The vertical active period time in number of Horizontal lines.

  csi-hsa:
    type: int
    required: false
    description: |
      The Horizontal Synchronism Active time in PIXCLK.

  csi-hbp:
    type: int
    required: false
    description: |
      The Horizontal back porch time in PIXCLK.

  csi-hsd:
    type: int
    required: false
    description: |
      The Horizontal synch porch time in PIXCLK.

  csi-hact:
    type: int
    required: false
    description: |
      The Horizontal active time in PIXCLK.

  rx-ddr-clk:
    type: int
    required: false
    default: 400000000
    description: |
      The value of RX DDR Lane Clock coming from CMOS sensor to RX D-PHY and
      further to MIPI-CSI IP as RXBYTECLKHS.
```
